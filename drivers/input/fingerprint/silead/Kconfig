## drivers/input/fingerprint/silead/Kconfig
```kconfig
#
# Silead Fingerprint driver configuration
#

config SILEAD_FP
	tristate "Silead Fingerprint driver support"
	help
	  This supports Silead Fingerprint drivers.

config SILEAD_FP_SPI
	tristate "Silead spi Fingerprint driver support"
	select SILEAD_FP
	help
	  This supports Silead spi Fingerprint drivers.

config SILEAD_FP_PLATFORM
	tristate "Silead platformm Fingerprint driver support"
	select SILEAD_FP
	help
	  This supports Silead platform Fingerprint drivers.

config MTK_SILEAD_FP_6153E_FOR_ORIENTATION
	tristate "silead fp navi for 6153E"
	default n
	help
	  This support silead for navi orientation
```

## drivers/input/touchscreen/mediatek/focal_touch/Kconfig
```kconfig
#
# Touchscreen driver configuration
#
config TOUCHSCREEN_MTK_FOCALTECH_TS
    bool "Focaltech Ts for Mediatek"
    depends on I2C
    default y
    help
      Say Y here if you have Focaltech touch panel.
      If unsure, say N.
      
config TOUCHSCREEN_MTK_FTS_DIRECTORY
    string "Focaltech ts directory name"
    default "focaltech_touch"
    depends on TOUCHSCREEN_MTK_FOCALTECH_TS
	
config TS_FIRMWARE
	string "config firmware folder for different project"
	default "firmware_vinus"
    
```

## drivers/misc/mediatek/sensors-1.0/accelerometer/lsm6dse-i2c/Kconfig
```kconfig
config ST_LSM6DSE_IMU
	bool "STMicroelectronics LSM6DSE IMU"
	depends on I2C
        default n
	help
	  Say Y here if you have a STMicroelectronics LSM6DSE IMU
	  connected to your system.

	  If unsure, say N.
```

## drivers/misc/mediatek/sensors-1.0/alsps/ltr556/Kconfig
```kconfig
config MTK_LTR556
	bool "ltr556 for MediaTek package"
	default n
	help
	  It support different type sensor
	  in this platform. If this option
	  is set, it will support ambient
	  and light sensor LTR556.
```

## drivers/misc/mediatek/sensors-1.0/hall_sensor/Kconfig
```kconfig
config CUSTOM_KERNEL_HALL_SENSOR
	bool "CUSTOM KERNEL HALL Config"
	help
	  To detect hall sensor
```
